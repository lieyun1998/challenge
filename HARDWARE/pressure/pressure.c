#include "rs485.h"	 
#include "system.h"
#include "SysTick.h"
#include "led.h"
#include "usart.h"
#include "stdarg.h"	 	 
#include "stdio.h"	 	 
#include "string.h"	 
//发射缓存区
u8 RS485_TX_BUF[2048];     //接收缓冲,最大2048个字节.

//接收缓存区 	
u8 RS485_RX_BUF[2048];  	//接收缓冲,最大2048个字节.

//接收到的数据长度
u8 RS485_RX_CNT=0;  

u8 point =0;

//CRC16校验 自己后面添加的
const u8 auchCRCHi[] = { 
0x00, 0xC1, 0x81, 0x40, 0x01, 0xC0, 0x80, 0x41, 0x01, 0xC0,0x80, 0x41, 0x00, 0xC1, 0x81, 0x40, 0x01, 0xC0, 0x80, 0x41, 
0x00, 0xC1, 0x81, 0x40, 0x00, 0xC1, 0x81, 0x40, 0x01, 0xC0,0x80, 0x41, 0x01, 0xC0, 0x80, 0x41, 0x00, 0xC1, 0x81, 0x40, 
0x00, 0xC1, 0x81, 0x40, 0x01, 0xC0, 0x80, 0x41, 0x00, 0xC1,0x81, 0x40, 0x01, 0xC0, 0x80, 0x41, 0x01, 0xC0, 0x80, 0x41, 
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0x00, 0xC1, 0x81, 0x40, 0x01, 0xC0, 0x80, 0x41, 0x01, 0xC0,0x80, 0x41, 0x00, 0xC1, 0x81, 0x40} ; 


const u8 auchCRCLo[] = { 
0x00, 0xC0, 0xC1, 0x01, 0xC3, 0x03, 0x02, 0xC2, 0xC6, 0x06,0x07, 0xC7, 0x05, 0xC5, 0xC4, 0x04, 0xCC, 0x0C, 0x0D, 0xCD, 
0x0F, 0xCF, 0xCE, 0x0E, 0x0A, 0xCA, 0xCB, 0x0B, 0xC9, 0x09,0x08, 0xC8, 0xD8, 0x18, 0x19, 0xD9, 0x1B, 0xDB, 0xDA, 0x1A, 
0x1E, 0xDE, 0xDF, 0x1F, 0xDD, 0x1D, 0x1C, 0xDC, 0x14, 0xD4,0xD5, 0x15, 0xD7, 0x17, 0x16, 0xD6, 0xD2, 0x12, 0x13, 0xD3, 
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0x44, 0x84, 0x85, 0x45, 0x87, 0x47, 0x46, 0x86, 0x82, 0x42,0x43, 0x83, 0x41, 0x81, 0x80, 0x40} ;


u16 CRC_Compute(u8 *puchMsg, u16 usDataLen) 
{ 
	u8 uchCRCHi = 0xFF ; 
	u8 uchCRCLo = 0xFF ; 
	u32 uIndex ; 
	while (usDataLen--) 
	{ 
		uIndex = uchCRCHi ^ *puchMsg++ ; 
		uchCRCHi = uchCRCLo ^ auchCRCHi[uIndex] ; 
		uchCRCLo = auchCRCLo[uIndex] ; 
	} 
	return ((uchCRCHi<< 8)  | (uchCRCLo)) ; 
}


//void USART2_IRQHandler(void)
//{
//	u8 res;	    
// 
//	
// 	if(USART_GetITStatus(USART2, USART_IT_RXNE) != RESET)//接收到数据
//	{	  
//   
//		res =USART_ReceiveData(USART2); 	//读取接收到的数据
//		if(RS485_RX_CNT<8)//这里有点问题，长度有待测量
//		{
//			RS485_RX_BUF[RS485_RX_CNT++]=res;		//记录接收到的值
//				
//		
//		} 
//		else
//		{
//		
//		  RS485_RX_CNT=0;
//			point=0;
//		}
//	}  											 
//} 


//#endif										 
//初始化IO 串口2
//pclk1:PCLK1时钟频率(Mhz)
//bound:波特率	  
void RS485_Init(u32 bound)
{  
			NVIC_InitTypeDef NVIC_InitStructure;
	GPIO_InitTypeDef GPIO_InitStructure;
	USART_InitTypeDef USART_InitStructure;
 
	USART_DeInit(USART2);  //复位串口3
	
	RCC_AHB1PeriphClockCmd(RCC_AHB1Periph_GPIOA,ENABLE); //使能GPIOB时钟
	RCC_APB1PeriphClockCmd(RCC_APB1Periph_USART2,ENABLE);//使能USART3时钟
	
 
	 GPIO_InitStructure.GPIO_Pin = GPIO_Pin_2 | GPIO_Pin_3; //GPIOB11和GPIOB10初始化
	GPIO_InitStructure.GPIO_Mode = GPIO_Mode_AF;//复用功能
	GPIO_InitStructure.GPIO_Speed = GPIO_Speed_50MHz;	//速度50MHz
	GPIO_InitStructure.GPIO_OType = GPIO_OType_PP; //推挽复用输出
	GPIO_InitStructure.GPIO_PuPd = GPIO_PuPd_UP; //上拉
	GPIO_Init(GPIOA,&GPIO_InitStructure); //初始化GPIOB11，和GPIOB10
	
	
	GPIO_PinAFConfig(GPIOA,GPIO_PinSource2,GPIO_AF_USART2); //GPIOB11复用为USART3
	GPIO_PinAFConfig(GPIOA,GPIO_PinSource3,GPIO_AF_USART2); //GPIOB10复用为USART3	  
	
	USART_InitStructure.USART_BaudRate = bound;//波特率一般设置为9600;
	USART_InitStructure.USART_WordLength = USART_WordLength_8b;//字长为8位数据格式
	USART_InitStructure.USART_StopBits = USART_StopBits_1;//一个停止位
	USART_InitStructure.USART_Parity = USART_Parity_No;//无奇偶校验位
	USART_InitStructure.USART_HardwareFlowControl = USART_HardwareFlowControl_None;//无硬件数据流控制
	USART_InitStructure.USART_Mode = USART_Mode_Rx | USART_Mode_Tx;	//收发模式
	USART_Init(USART2, &USART_InitStructure); //初始化串口3
	
	USART_ITConfig(USART2, USART_IT_RXNE, ENABLE);//开启中断  
		
	USART_Cmd(USART2, ENABLE);                    //使能串口 
	
 
	NVIC_InitStructure.NVIC_IRQChannel = USART2_IRQn;
	NVIC_InitStructure.NVIC_IRQChannelPreemptionPriority=2 ;//抢占优先级2
	NVIC_InitStructure.NVIC_IRQChannelSubPriority = 3;		//子优先级3
	NVIC_InitStructure.NVIC_IRQChannelCmd = ENABLE;			//IRQ通道使能
	NVIC_Init(&NVIC_InitStructure);	//根据指定的参数初始化VIC寄存器
	
	RS485_RX_CNT=0;	
  point =0;
}

//RS485发送len个字节.
//buf:发送区首地址
//len:发送的字节数(为了和本代码的接收匹配,这里建议不要超过64个字节)
void RS485_Send_Data(u8 *buf,u8 len)
{
	u8 t;
	
	//RS485_TX_EN=1;			//设置为发送模式
	
  	for(t=0;t<len;t++)		//循环发送数据
	{		   
		while(USART_GetFlagStatus(USART2,USART_FLAG_TXE)==RESET);
		USART_SendData(USART2,buf[t]);
	}	 
	
    while(USART_GetFlagStatus(USART2, USART_FLAG_TC) == RESET);
		
	RS485_RX_CNT=0;	  
	point =1;

}


void RS485_Send_Weather_Station_Instructions(void)
{
	u8 RS485_TX_BUF3[1]={2};
	u16 calCRC;
	RS485_TX_BUF[0] = 0x01;//485温湿度传感器地址
	RS485_TX_BUF[1] = 0x03;//功能码
	RS485_TX_BUF[2] = 0x00;
	RS485_TX_BUF[3] = 0x50;
	RS485_TX_BUF[4] = 0x00;
	RS485_TX_BUF[5] = 0x02;
  RS485_TX_BUF[6] = 0XC4;//CRC高字节
	RS485_TX_BUF[7] = 0X1A;   //CRC低字节
	
	RS485_Send_Data(RS485_TX_BUF,8);
}

//RS485查询接收到的数据
//buf:接收缓存首地址
//len:读到的数据长度
void RS485_Receive_Data(void)
{
	u32 c;
	u32 a;
	u32 b;
	u8 rxlen=RS485_RX_CNT;
	
	if(rxlen==RS485_RX_CNT&&rxlen)//接收到了数据,且接收完成了
	{
		c=(RS485_RX_BUF[4]<<8)|(RS485_RX_BUF[5]);
		a=RS485_RX_BUF[6];
		b=RS485_RX_BUF[5];
	//	printf("标志：%d\r\n",2);
		
    USART_SendData(USART1,RS485_RX_BUF[5]);
		
		
		RS485_RX_CNT=0;		//清零
		//point =0;
	}

}

void RS485_Sending_And_Receiving_Time_Control(void)
{

	switch(point)
	{
		case 0:RS485_Send_Weather_Station_Instructions();LED1=0;break;
		case 1:RS485_Receive_Data();LED1=1;break;					
	}
}



















